## main/Kconfig.projbuild
```kconfig
menu "Home interface config"
    config OLED_USE_I2C_DISPLAY
        bool "OLED_USE_I2C_DISPLAY"
        default true
        help
            Whether to use I2C instead of SPI
endmenu
```
